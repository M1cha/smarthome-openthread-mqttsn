## modules/Kconfig
```kconfig
menu "modules"
rsource "mqttsndev/Kconfig"
rsource "rust/Kconfig"
rsource "watchdog/Kconfig"
endmenu
```

## modules/mqttsndev/Kconfig
```kconfig
config SMARTHOME_MQTTSN_DEVICE
	bool "Enable MQTTSN device library"

if SMARTHOME_MQTTSN_DEVICE

config SMARTHOME_MQTTSN_DEVICE_MQTTSN_ENABLED
	bool "Enable MQTT-SN client"
	default y
	help
	  While this is the main purpose of this library, there is some code in
	  here, that's useful for the router application, which doesn't need
	  MQTT-SN.

config SMARTHOME_MQTTSN_DEVICE_MAX_CLIENTID_LENGTH
	int "Max client ID length"
	default 23

config SMARTHOME_MQTTSN_DEVICE_BUFFER_SIZE
	int "Size of the TX and RX buffers"
	default 255

config SMARTHOME_MQTTSN_DEVICE_RETRY_WAIT_DURATION
	int "Number of seconds to wait before attempting a retry after errors"
	default 10

config SMARTHOME_MQTTSN_DEVICE_RECONNECT_WAIT_DURATION
	int "Number of seconds to wait before attempting a reconnect"
	default 60

config SMARTHOME_MQTTSN_DEVICE_WDT_MAX_WINDOW_MS
	int "Watchdog max window"
	default 120000
	depends on WATCHDOG

config SMARTHOME_MQTTSN_DEVICE_WDT_FEED_INTERVAL_MS
	int "Watchdog feed interval"
	default 10000
	depends on WATCHDOG

module = SMARTHOME_MQTTSN_DEVICE
module-str = smarthome mqttsn device
source "subsys/logging/Kconfig.template.log_config"

endif # SMARTHOME_MQTTSN_DEVICE
```

## modules/rust/Kconfig
```kconfig
config SMARTHOME_RUST
	bool "smarthome rust code"

config SMARTHOME_RUST_LOGGER
	bool "enable smarthome logger"

config SMARTHOME_DEBUG_PROFILE
	bool "build with debug information"
```

## modules/watchdog/Kconfig
```kconfig
config SMARTHOME_WATCHDOG
	bool "Enable smarthome watchdog"
	depends on WATCHDOG

if SMARTHOME_WATCHDOG

config SMARTHOME_WATCHDOG_MAX_WINDOW_MS
	int "Watchdog max window"
	default 120000

config SMARTHOME_WATCHDOG_FEED_INTERVAL_MS
	int "Watchdog feed interval"
	default 10000

module = SMARTHOME_WATCHDOG
module-str = smarthome watchdog
source "subsys/logging/Kconfig.template.log_config"

endif # SMARTHOME_WATCHDOG
```

## west.yml
```yaml
manifest:
  self:
    path: smarthome-openthread-mqttsn

  remotes:
    - name: zephyrproject-rtos
      url-base: https://github.com/zephyrproject-rtos

  projects:
    - name: zephyr
      remote: zephyrproject-rtos
      revision: v4.4.1
      import:
        name-allowlist:
          - cmsis
          - cmsis_6
          - hal_nordic
          - mbedtls
          - mcuboot
          - openthread
          - segger
          - tf-psa-crypto
          - zcbor
```
