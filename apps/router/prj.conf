## CMakeLists.txt
```
# SPDX-License-Identifier: Apache-2.0

cmake_minimum_required(VERSION 3.20.0)

find_package(Zephyr REQUIRED HINTS $ENV{ZEPHYR_BASE})
project(router)

target_sources(app PRIVATE
	src/main.c
)
target_link_libraries(app PRIVATE
	SMARTHOME_MQTTSN_DEVICE
)
```

## prj.conf
```kconfig
# Logging
CONFIG_NET_LOG=y
CONFIG_LOG=y
CONFIG_PRINTK=y

# Debugging
CONFIG_DEBUG_THREAD_INFO=y

CONFIG_OPENTHREAD_MTD=n
CONFIG_OPENTHREAD_FTD=y
CONFIG_OPENTHREAD_DEFAULT_TX_POWER=8
CONFIG_SMARTHOME_MQTTSN_DEVICE_MQTTSN_ENABLED=n
```

## src/main.c
```c
/*
 * SPDX-License-Identifier: Apache-2.0
 */

#include <zephyr/kernel.h>
#include <smarthome/mqttsndev.h>

#include <zephyr/logging/log.h>
LOG_MODULE_REGISTER(router, CONFIG_APP_LOG_LEVEL);

int main(void)
{
	LOG_DBG("Init");
	mqttsndev_init();
	return 0;
}
```
