## prj.conf
```kconfig
CONFIG_NETWORKING=y
CONFIG_NET_L2_OPENTHREAD=y

# Disable certain parts of Zephyr IPv6 stack
CONFIG_NET_IPV6_NBR_CACHE=n
CONFIG_NET_IPV6_MLD=n

# Logging
CONFIG_LOG=y
CONFIG_LOG_MODE_MINIMAL=n

# Debugging
CONFIG_DEBUG_THREAD_INFO=y

# Use NVS as settings backend
CONFIG_NVS=y

# Kernel options
CONFIG_MAIN_STACK_SIZE=2560
CONFIG_INIT_STACKS=y

# Increase logging thread stack size due to Spinel backend needs
CONFIG_LOG_PROCESS_THREAD_STACK_SIZE=2048

# Set OpenThread RCP architecture
CONFIG_OPENTHREAD_COPROCESSOR=y
CONFIG_OPENTHREAD_COPROCESSOR_RCP=y
CONFIG_NET_PKT_RX_COUNT=8
CONFIG_NET_PKT_TX_COUNT=8
CONFIG_OPENTHREAD_DEFAULT_TX_POWER=8

# Configs from Nordic fork
CONFIG_OPENTHREAD_THREAD_VERSION_1_4=y
CONFIG_OPENTHREAD_LINK_METRICS_INITIATOR=y
CONFIG_OPENTHREAD_LINK_METRICS_SUBJECT=y
CONFIG_OPENTHREAD_CSL_RECEIVER=y

# watchdog
CONFIG_WATCHDOG=y
CONFIG_WDT_DISABLE_AT_BOOT=n
CONFIG_SMARTHOME_WATCHDOG=y
```

## boards/nrf52840dk_nrf52840.conf
```kconfig
# Use USB-CDC-ACM for Co-Processor
CONFIG_USB_DEVICE_STACK_NEXT=y
CONFIG_CDC_ACM_SERIAL_INITIALIZE_AT_BOOT=y
CONFIG_CDC_ACM_SERIAL_PRODUCT_STRING="OpenThread CoProcessor NRF"
CONFIG_USBD_CDC_ACM_LOG_LEVEL_OFF=y
CONFIG_UART_LINE_CTRL=y

CONFIG_ISR_STACK_SIZE=4096

CONFIG_NRF_802154_ASSERT_ZEPHYR=y
```

## boards/nrf52840dk_nrf52840.overlay
```dts
/ {
	chosen {
		zephyr,ot-uart = &cdc_acm_uart;
	};
};

&zephyr_udc0 {
	cdc_acm_uart: cdc_acm_uart {
		compatible = "zephyr,cdc-acm-uart";
	};
};
```

## src/main.c
```c
/* main.c - OpenThread NCP */

/*
 * Copyright (c) 2020 Tridonic GmbH & Co KG
 *
 * SPDX-License-Identifier: Apache-2.0
 */

#include <zephyr/logging/log.h>
LOG_MODULE_REGISTER(ot_br, LOG_LEVEL_DBG);

#define APP_BANNER "***** OpenThread RCP on Zephyr %s *****"

uint8_t *usb_update_sn_string_descriptor(void)
{
	static char sn[] = "3804D0A373C4BD19";
	return sn;
}

int main(void)
{
	LOG_INF(APP_BANNER, CONFIG_NET_SAMPLE_APPLICATION_VERSION);
	return 0;
}
```
